/*
 * Copyright (c) 2022 The ZMK Contributors
 *
 * SPDX-License-Identifier: MIT
 */

#include "matrix-transform.dtsi"

/ {
  chosen {
    zmk,kscan = &kscan0;
    zmk,physical-layout = &default_layout;
  };

  kscan0: kscan_0 {
    compatible = "zmk,kscan-gpio-matrix";
    label = "KSCAN";
        
    diode-direction = "col2row"; 
    row-gpios = <&pro_micro 4 (GPIO_ACTIVE_HIGH | GPIO_PULL_DOWN)>,
                <&pro_micro 5 (GPIO_ACTIVE_HIGH | GPIO_PULL_DOWN)>,
                <&pro_micro 6 (GPIO_ACTIVE_HIGH | GPIO_PULL_DOWN)>,
                <&pro_micro 7 (GPIO_ACTIVE_HIGH | GPIO_PULL_DOWN)>;
  };
};