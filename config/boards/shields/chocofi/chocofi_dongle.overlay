/*
 * Copyright (c) 2022 The ZMK Contributors
 *
 * SPDX-License-Identifier: MIT
 */

#include "matrix-transform.dtsi"

/ {
  chosen {
    zmk,kscan = &mock_kscan;
    zmk,physical-layout = &default_layout;
  };

  mock_kscan: mock_kscan_0 {
    compatible = "zmk,kscan-mock";
    columns = <0>;
    rows = <0>;
    events = <0>;
  };
};