## config/Kconfig
```kconfig
DT_COMPAT_ZMK_BEHAVIOR_CASE_MODE := zmk,behavior-case-mode

config ZMK_BEHAVIOR_WORD_CASE
	bool
	default $(dt_compat_enabled,$(DT_COMPAT_ZMK_BEHAVIOR_CASE_MODE))
```

## config/boards/shields/chocofi/Kconfig.defconfig
```kconfig
# Copyright (c) 2022 The ZMK Contributors
# SPDX-License-Identifier: MIT

if SHIELD_CHOCOFI_DONGLE

config ZMK_KEYBOARD_NAME
    default "CHOCOFI"
    
config ZMK_SPLIT_ROLE_CENTRAL
    default y

config ZMK_SPLIT_BLE_CENTRAL_PERIPHERALS
    default 2

config ZMK_USB
    default y

endif

if SHIELD_CHOCOFI_LEFT || SHIELD_CHOCOFI_RIGHT || SHIELD_CHOCOFI_DONGLE

config ZMK_SPLIT
    default y

config ZMK_BLE
    default y

endif
```

## config/boards/shields/sweep/Kconfig.defconfig
```kconfig
# Copyright (c) 2022 The ZMK Contributors
# SPDX-License-Identifier: MIT

if SHIELD_SWEEP_DONGLE

config ZMK_KEYBOARD_NAME
    default "SWEEP"
    
config ZMK_SPLIT_ROLE_CENTRAL
    default y

config ZMK_SPLIT_BLE_CENTRAL_PERIPHERALS
    default 2

config ZMK_USB
    default y

endif

if SHIELD_SWEEP_LEFT || SHIELD_SWEEP_RIGHT || SHIELD_SWEEP_DONGLE

config ZMK_SPLIT
    default y

config ZMK_BLE
    default y

endif
```

## config/dts/bindings/behaviors/zmk,behavior-case-mode.yaml
```yaml
description: Select or toggle a word case mode
compatible: "zmk,behavior-case-mode"
include: one_param.yaml
```
