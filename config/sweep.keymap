#include "zmk-helpers/key-labels/34.h"
#include "base.dtsi"

ZMK_BASE_LAYER(Base,
//╭───────────┬───────────┬───────────┬───────────┬───────────╮ ╭───────────┬───────────┬───────────┬───────────┬───────────╮
    &kp Q       &kp W       &kp E       &kp R       &kp T     ,   &kp Y       &kp U       &kp I       &kp O       &kp P     ,
//├───────────┼───────────┼───────────┼───────────┼───────────┤ ├───────────┼───────────┼───────────┼───────────┼───────────┤
    HMLC A      HMLA S      HMLS D      HMLG F      &kp G     ,   &kp H       HMRG J      HMRS K      HMRA L      HMRC SQT  ,
//|───────────┼───────────┼───────────┼───────────┼───────────┤ ├───────────┼───────────┼───────────┼───────────┼───────────┤
    &kp Z       &kp X       &kp C       &kp V       &kp B     ,   &kp N       &kp M       &comma_m    &dot_m      &qexcl    ,
//╰───────────┴───────────┴───────────┼───────────┴───────────┤ ├───────────┼───────────┴───────────┼───────────┴───────────╯
                                        &kp SPACE   &mo NAV   ,   &mo NUM     &kp SPACE   
//                                    ╰───────────┴───────────╯ ╰───────────┴───────────╯
)

ZMK_BASE_LAYER(Casemode_Under,
//╭───────────┬───────────┬───────────┬───────────┬───────────╮ ╭───────────┬───────────┬───────────┬───────────┬───────────╮
    ___         ___         ___         ___         ___       ,   ___         ___         ___         ___         ___       ,
//├───────────┼───────────┼───────────┼───────────┼───────────┤ ├───────────┼───────────┼───────────┼───────────┼───────────┤
    ___         ___         ___         ___         ___       ,   ___         ___         ___         ___         ___       ,
//|───────────┼───────────┼───────────┼───────────┼───────────┤ ├───────────┼───────────┼───────────┼───────────┼───────────┤
    ___         ___         ___         ___         ___       ,   ___         ___         ___         ___         ___       ,
//╰───────────┴───────────┴───────────┼───────────┴───────────┤ ├───────────┼───────────┴───────────┼───────────┴───────────╯
                                        UNDER_C     CANCEL    ,   ___         UNDER_C    
//                                    ╰───────────┴───────────╯ ╰───────────┴───────────╯
)

ZMK_BASE_LAYER(Casemode_Slash,
//╭───────────┬───────────┬───────────┬───────────┬───────────╮ ╭───────────┬───────────┬───────────┬───────────┬───────────╮
    ___         ___         ___         ___         ___       ,   ___         ___         ___         ___         ___       ,
//├───────────┼───────────┼───────────┼───────────┼───────────┤ ├───────────┼───────────┼───────────┼───────────┼───────────┤
    ___         ___         ___         ___         ___       ,   ___         ___         ___         ___         ___       ,
//|───────────┼───────────┼───────────┼───────────┼───────────┤ ├───────────┼───────────┼───────────┼───────────┼───────────┤
    ___         ___         ___         ___         ___       ,   ___         ___         ___         ___         ___       ,
//╰───────────┴───────────┴───────────┼───────────┴───────────┤ ├───────────┼───────────┴───────────┼───────────┴───────────╯
                                        SLASH_C     CANCEL    ,   ___         SLASH_C   
//                                    ╰───────────┴───────────╯ ╰───────────┴───────────╯
)

ZMK_BASE_LAYER(Casemode_Dash,
//╭───────────┬───────────┬───────────┬───────────┬───────────╮ ╭───────────┬───────────┬───────────┬───────────┬───────────╮
    ___         ___         ___         ___         ___       ,   ___         ___         ___         ___         ___       ,
//├───────────┼───────────┼───────────┼───────────┼───────────┤ ├───────────┼───────────┼───────────┼───────────┼───────────┤
    ___         ___         ___         ___         ___       ,   ___         ___         ___         ___         ___       ,
//|───────────┼───────────┼───────────┼───────────┼───────────┤ ├───────────┼───────────┼───────────┼───────────┼───────────┤
    ___         ___         ___         ___         ___       ,   ___         ___         ___         ___         ___       ,
//╰───────────┴───────────┴───────────┼───────────┴───────────┤ ├───────────┼───────────┴───────────┼───────────┴───────────╯
                                        DASH_C      CANCEL    ,   ___         DASH_C      
//                                    ╰───────────┴───────────╯ ╰───────────┴───────────╯
)

ZMK_BASE_LAYER(Nav,
//╭───────────┬───────────┬───────────┬───────────┬───────────╮ ╭───────────┬───────────┬───────────┬───────────┬───────────╮
    XXX         XXX         CAPS_UNDER   WORD_UNDER  WORD_PATH ,   SSHOT       WORD_B      NAV_UP      WORD_F      NAV_DEL   ,
//├───────────┼───────────┼───────────┼───────────┼───────────┤ ├───────────┼───────────┼───────────┼───────────┼───────────┤
    &kp LCTRL   &kp LALT    &kp LSHFT   &kp LGUI    SWAP      ,   LAUNCH      NAV_LEFT    NAV_DOWN    NAV_RIGHT   &kp RET   ,
//|───────────┼───────────┼───────────┼───────────┼───────────┤ ├───────────┼───────────┼───────────┼───────────┼───────────┤
    XXX         XXX         XXX         WORD_SHIFT  UNTAB     ,   TERM        &kp PUP     CMNT        &kp PDN     NAV_BSPC  ,
//╰───────────┴───────────┴───────────┼───────────┴───────────┤ ├───────────┼───────────┴───────────┼───────────┴───────────╯
                                        &kp SPACE   &mo NAV   ,   ___         &kp SPACE  
//                                    ╰───────────┴───────────╯ ╰───────────┴───────────╯
)

ZMK_BASE_LAYER(Num,
//╭───────────┬───────────┬───────────┬───────────┬───────────╮ ╭───────────┬───────────┬───────────┬───────────┬───────────╮
    &kp SLASH   &kp N7      &kp N8      &kp N9      &kp PLUS  ,   XXX         XXX         XXX         XXX         XXX       ,
//├───────────┼───────────┼───────────┼───────────┼───────────┤ ├───────────┼───────────┼───────────┼───────────┼───────────┤
    HMLC N0     HMLA N4     HMLS N5     HMLG N6     &kp DOT   ,   CANCEL      &kp LGUI    &kp LSHFT   &kp LALT    &kp LCTRL ,
//|───────────┼───────────┼───────────┼───────────┼───────────┤ ├───────────┼───────────┼───────────┼───────────┼───────────┤
    &kp ASTRK   &kp N1      &kp N2      &kp N3      &kp MIN   ,   XXX         XXX         &kp COMMA   &kp DOT     XXX       ,
//╰───────────┴───────────┴───────────┼───────────┴───────────┤ ├───────────┼───────────┴───────────┼───────────┴───────────╯
                                        ___         ___       ,   ___         ___        
//                                    ╰───────────┴───────────╯ ╰───────────┴───────────╯
)

ZMK_BASE_LAYER(Fn,
//╭───────────┬───────────┬───────────┬───────────┬───────────╮ ╭───────────┬───────────┬───────────┬───────────┬───────────╮
    &kp F12     &kp F7      &kp F8      &kp F9      BOOT      ,   BOOT        PREV        &kp VUP     NEXT        PLAY_P    ,
//├───────────┼───────────┼───────────┼───────────┼───────────┤ ├───────────┼───────────┼───────────┼───────────┼───────────┤
    HMLC F11    HMLA F4     HMLS F5     HMLG F6     SWAP      ,   &kp BRK     HMRG PUP    HMRS VDN    HMRA PDN    &kp LCTRL ,
//|───────────┼───────────┼───────────┼───────────┼───────────┤ ├───────────┼───────────┼───────────┼───────────┼───────────┤
    &kp F10     &kp F1      &kp F2      &kp F3      UNTAB     ,   STUDIO      XXX         MUTE        XXX         XXX       ,
//╰───────────┴───────────┴───────────┼───────────┴───────────┤ ├───────────┼───────────┴───────────┼───────────┴───────────╯
                                        ___         ___       ,   ___         ___         
//                                    ╰───────────┴───────────╯ ╰───────────┴───────────╯
)
